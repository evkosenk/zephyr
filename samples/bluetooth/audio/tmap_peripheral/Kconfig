## samples/bluetooth/audio/tmap_peripheral/Kconfig
```kconfig
#
# Copyright (c) 2022 Codecoup
# Copyright 2023 NXP
#
# SPDX-License-Identifier: Apache-2.0
#

# LC3 decode plus audio_codec bring-up push main and sysworkq past their
# defaults. Declared before Kconfig.zephyr so our defaults are searched
# ahead of kernel/Kconfig's defaults.
if LIBLC3

config MAIN_STACK_SIZE
	default 4096

config SYSTEM_WORKQUEUE_STACK_SIZE
	default 4096

endif # LIBLC3

mainmenu "Bluetooth: Earbuds"

menu "Zephyr"
source "Kconfig.zephyr"
endmenu

menu "Earbuds"

menuconfig SAMPLE_TMAP_AUDIO_CAPTURE
	bool "Send I2S microphone audio on the unicast source"
	depends on SAMPLE_BT_AUDIO_PLAYBACK_SINK_I2S
	depends on SAMPLE_BT_AUDIO_PLAYBACK_FULL_DUPLEX
	depends on SAMPLE_BT_AUDIO_PLAYBACK_CODEC_CLOCK_CONTROLLER
	depends on $(dt_alias_enabled,i2s-codec-rx)
	depends on BT_ASCS_MAX_ASE_SRC_COUNT = 1
	help
	  Capture 48 kHz stereo PCM and encode one input channel as a 32 kHz,
	  10 ms mono LC3 source. Playback and capture share the codec clocks
	  and use a fixed 48 kHz PCM format. Playback accepts 10 ms frames.

if SAMPLE_TMAP_AUDIO_CAPTURE

choice SAMPLE_TMAP_AUDIO_CAPTURE_CHANNEL
	prompt "Microphone channel"
	default SAMPLE_TMAP_AUDIO_CAPTURE_RIGHT

config SAMPLE_TMAP_AUDIO_CAPTURE_LEFT
	bool "Left"

config SAMPLE_TMAP_AUDIO_CAPTURE_RIGHT
	bool "Right"

endchoice

endif # SAMPLE_TMAP_AUDIO_CAPTURE

config TMAP_PERIPHERAL_SET_RANK
	int "Device rank in set"
	depends on TMAP_PERIPHERAL_DUO
	range 1 2
	help
	  Rank of this device in set.

choice TMAP_PERIPHERAL_TYPE_CHOICE
	prompt "Earbuds type"
	help
	  Select the Earbuds Type to compile.

config TMAP_PERIPHERAL_SINGLE
	bool "Single ear headset"

config TMAP_PERIPHERAL_DUO
	depends on BT_CAP_ACCEPTOR_SET_MEMBER
	bool "Duo headset"

endchoice # TMAP_PERIPHERAL_TYPE_CHOICE

choice TMAP_PERIPHERAL_LOCATION
	prompt "Earbud Location"
	help
	  Select the Earbud location.

config TMAP_PERIPHERAL_LEFT
	bool "Left Ear"

config TMAP_PERIPHERAL_RIGHT
	bool "Right Ear"

config TMAP_PERIPHERAL_STEREO
	bool "Stereo speaker (front left + front right)"
	help
	  Advertise the sink and source PAC locations as a stereo speaker.
	  Required by some phones (e.g. Pixel running Android) before they
	  will route stereo media to a solo LE Audio device.

endchoice # TMAP_PERIPHERAL_LOCATION

config TMAP_PERIPHERAL_ROLE_CT
	bool "TMAP Call Terminal (CT) role"
	default y
	help
	  Advertise the TMAP Call Terminal role. Compiles in and
	  initializes the CCP client used to interact with a peer Call
	  Gateway (typically a phone). Disable to build a media-only
	  peripheral that does not participate in call control.

config TMAP_PERIPHERAL_ROLE_UMR
	bool "TMAP Unicast Media Receiver (UMR) role"
	default y
	help
	  Advertise the TMAP Unicast Media Receiver role. Compiles in and
	  initializes the MCP client on top of the BAP unicast sink to
	  interact with a peer Unicast Media Sender. Disabling drops the MCP
	  client and stops advertising the UMR role; the BAP unicast sink is
	  always built, so the peripheral still accepts a sink stream and plays
	  received media but no longer drives media control.

config TMAP_PERIPHERAL_AUTO_CTRL
	bool "Run the CT/MCC control demo after TMAP discovery"
	depends on TMAP_PERIPHERAL_ROLE_CT || TMAP_PERIPHERAL_ROLE_UMR
	default y
	help
	  When enabled the sample originates a call via CCP and issues a
	  play/pause via MCP after discovering the peer. Disable this to
	  keep the sample as a passive media sink (UMR) that waits for the
	  peer to open a CIS to it.

rsource "../common/Kconfig"

endmenu
```

## samples/bluetooth/audio/tmap_peripheral/boards/mimxrt1170_evk_mimxrt1176_cm7_B.conf
```kconfig
# SPDX-FileCopyrightText: Copyright The Zephyr Project Contributors
# SPDX-License-Identifier: Apache-2.0

CONFIG_AUDIO=y
CONFIG_AUDIO_CODEC=y
CONFIG_I2S=y
CONFIG_FPU=y
CONFIG_LIBLC3=y
CONFIG_SAMPLE_BT_AUDIO_PLAYBACK_48KHZ=y
CONFIG_SAMPLE_BT_AUDIO_PLAYBACK_CODEC_CLOCK_CONTROLLER=y
CONFIG_SAMPLE_BT_AUDIO_PLAYBACK_FULL_DUPLEX=y
CONFIG_SAMPLE_BT_AUDIO_PLAYBACK_CODEC_VOL_MIN=0
CONFIG_SAMPLE_BT_AUDIO_PLAYBACK_CODEC_VOL_MAX=127
CONFIG_SAMPLE_TMAP_AUDIO_CAPTURE=y
CONFIG_BT_ISO_TX_BUF_COUNT=8
CONFIG_TMAP_PERIPHERAL_AUTO_CTRL=n
```

## tests/bluetooth/shell/Kconfig
```kconfig
# Copyright (c) 2026 Nordic Semiconductor ASA
# SPDX-License-Identifier: Apache-2.0

mainmenu "Bluetooth Shell Test Application"

configdefault MAIN_STACK_SIZE
	default 4096 if TEST_BT_SHELL_TMAP_AUDIO

configdefault SYSTEM_WORKQUEUE_STACK_SIZE
	default 4096 if TEST_BT_SHELL_TMAP_AUDIO

configdefault SAMPLE_BT_AUDIO_PLAYBACK_CODEC_VOL_MAX
	default 127 if TEST_BT_SHELL_TMAP_AUDIO && DT_HAS_WOLFSON_WM8962_ENABLED

# LE Audio Controller settings for non-network core devices
if BT_AUDIO && BT_LL_SW_SPLIT

configdefault BT_CTLR_DATA_LENGTH_MAX
	default 251

# Set to high value to support large BASEs + extra data
configdefault BT_CTLR_SCAN_DATA_LEN_MAX
	default 1650

configdefault BT_CTLR_ADV_SYNC_SET
	default BT_CTLR_ADV_AUX_SET

configdefault BT_CTLR_ADV_DATA_LEN_MAX
	default 191

configdefault BT_CTLR_ADV_DATA_BUF_MAX
	default 6

# Match BT_BAP_BROADCAST_SRC_STREAM_COUNT in audio.conf
configdefault BT_CTLR_SYNC_ISO_STREAM_MAX
	default 2

# Match BT_BAP_BROADCAST_SNK_STREAM_COUNT in audio.conf
configdefault BT_CTLR_ADV_ISO_STREAM_MAX
	default 2

# Match BT_BAP_UNICAST_CLIENT_ASE_SRC_COUNT/BT_ASCS_MAX_ASE_SNK_COUNT audio.conf
configdefault BT_CTLR_ISOAL_SOURCES
	default 2

# BT_BAP_UNICAST_CLIENT_ASE_SNK_COUNT/BT_ASCS_MAX_ASE_SRC_COUNT in audio.conf
configdefault BT_CTLR_ISOAL_SINKS
	default 2

configdefault BT_CTLR_ISO_TX_BUFFER_SIZE
	default 255

configdefault BT_CTLR_ISO_TX_SDU_LEN_MAX
	default 247

endif # BT_AUDIO && BT_LL_SW_SPLIT

source "Kconfig.zephyr"

rsource "../../../samples/bluetooth/audio/common/Kconfig"

config TEST_BT_SHELL_TMAP_AUDIO
	bool "TMAP shell board audio input and output"
	depends on BT_TMAP && BT_BAP_UNICAST_SERVER && LIBLC3
	depends on SAMPLE_BT_AUDIO_PLAYBACK_SINK_I2S
	depends on SAMPLE_BT_AUDIO_PLAYBACK_FULL_DUPLEX
	depends on SAMPLE_BT_AUDIO_PLAYBACK_CODEC_CLOCK_CONTROLLER
	depends on $(dt_alias_enabled,i2s-codec-rx)
	depends on BT_ASCS_MAX_ASE_SNK_COUNT = 1 && BT_ASCS_MAX_ASE_SRC_COUNT = 1
	depends on !USBD_AUDIO2_CLASS
	help
	  Initialize board audio with tmap init and route a peripheral's
	  unicast sink to headphones and its source from an I2S microphone.
	  The codec supplies fixed 48 kHz clocks shared by both directions.
```
